## buildroot/configs/electronos_rpi5_defconfig
```kconfig
# ============================================================================
# electronOS Buildroot defconfig for Raspberry Pi 5
# ============================================================================

# ---- Architecture ---------------------------------------------------------
BR2_aarch64=y

# ---- Toolchain ------------------------------------------------------------
BR2_TOOLCHAIN_BUILDROOT_GLIBC=y
BR2_TOOLCHAIN_BUILDROOT_CXX=y
BR2_KERNEL_HEADERS_6_6=y
BR2_PACKAGE_HOST_GDB=y
BR2_GDB_VERSION_14=y
BR2_TOOLCHAIN_BUILDROOT_FORTIFY_LEVEL_2=y
BR2_RELRO_FULL=y
BR2_SSP_STRONG=y
BR2_PIE=y
BR2_FORTIFY_SOURCE_2=y

# ---- Build options --------------------------------------------------------
BR2_CCACHE=y
BR2_GLOBAL_PATCH_DIR="$(BR2_EXTERNAL_ELECTRONOS_PATH)/../board/electronos/patches"

# ---- System configuration -------------------------------------------------
BR2_TARGET_GENERIC_HOSTNAME="electronos"
BR2_TARGET_GENERIC_ISSUE="Welcome to electronOS"
BR2_TARGET_GENERIC_PASSWD_SHA512=y
BR2_INIT_SYSTEMD=y
BR2_ROOTFS_OVERLAY="$(BR2_EXTERNAL_ELECTRONOS_PATH)/../board/electronos/overlay"
BR2_ROOTFS_POST_BUILD_SCRIPT="$(BR2_EXTERNAL_ELECTRONOS_PATH)/../board/electronos/post-build.sh"
BR2_ROOTFS_POST_IMAGE_SCRIPT="$(BR2_EXTERNAL_ELECTRONOS_PATH)/../board/electronos/post-image.sh"
BR2_ROOTFS_POST_SCRIPT_ARGS="--genimage $(BR2_EXTERNAL_ELECTRONOS_PATH)/../board/electronos/genimage.cfg"

# ---- Kernel ---------------------------------------------------------------
BR2_LINUX_KERNEL=y
BR2_LINUX_KERNEL_CUSTOM_TARBALL=y
BR2_LINUX_KERNEL_CUSTOM_TARBALL_LOCATION="https://github.com/raspberrypi/linux/archive/refs/tags/stable_20241008.tar.gz"
BR2_LINUX_KERNEL_DEFCONFIG="bcm2712"
BR2_LINUX_KERNEL_CONFIG_FRAGMENT_FILES="$(BR2_EXTERNAL_ELECTRONOS_PATH)/../configs/kernel/security.fragment $(BR2_EXTERNAL_ELECTRONOS_PATH)/../configs/kernel/graphics.fragment"
BR2_LINUX_KERNEL_DTS_SUPPORT=y
BR2_LINUX_KERNEL_INTREE_DTS_NAME="broadcom/bcm2712-rpi-5-b"
BR2_LINUX_KERNEL_NEEDS_HOST_OPENSSL=y

# ---- Bootloader -----------------------------------------------------------
BR2_TARGET_UBOOT=y
BR2_TARGET_UBOOT_BUILD_SYSTEM_KCONFIG=y
BR2_TARGET_UBOOT_CUSTOM_VERSION=y
BR2_TARGET_UBOOT_CUSTOM_VERSION_VALUE="2024.10"
BR2_TARGET_UBOOT_BOARD_DEFCONFIG="rpi_arm64"

# ---- Firmware -------------------------------------------------------------
BR2_PACKAGE_RPI_FIRMWARE=y
BR2_PACKAGE_RPI_FIRMWARE_VARIANT_PI4_64=y

# ---- Filesystem -----------------------------------------------------------
BR2_TARGET_ROOTFS_EXT2=y
BR2_TARGET_ROOTFS_EXT2_4=y
BR2_TARGET_ROOTFS_EXT2_SIZE="2G"

# ---- Graphics stack -------------------------------------------------------
BR2_PACKAGE_MESA3D=y
BR2_PACKAGE_MESA3D_GALLIUM_DRIVER_V3D=y
BR2_PACKAGE_MESA3D_GALLIUM_DRIVER_VC4=y
BR2_PACKAGE_MESA3D_OPENGL_ES=y
BR2_PACKAGE_MESA3D_OPENGL_EGL=y
BR2_PACKAGE_LIBDRM=y
BR2_PACKAGE_LIBPNG=y
BR2_PACKAGE_JPEG_TURBO=y
BR2_PACKAGE_FREETYPE=y
BR2_PACKAGE_FONTCONFIG=y
BR2_PACKAGE_CAIRO=y
BR2_PACKAGE_PANGO=y
BR2_PACKAGE_SDL2=y
BR2_PACKAGE_SDL2_KMSDRM=y
BR2_PACKAGE_SDL2_IMAGE=y
BR2_PACKAGE_SDL2_TTF=y

# ---- Plymouth (boot splash) ----------------------------------------------
BR2_PACKAGE_PLYMOUTH=y

# ---- Security packages ----------------------------------------------------
BR2_PACKAGE_APPARMOR=y
BR2_PACKAGE_NFTABLES=y
BR2_PACKAGE_LIBPAM=y
BR2_PACKAGE_LIBPAM_CRACKLIB=y
BR2_PACKAGE_OPENSSL=y
BR2_PACKAGE_OPENSSH=y
BR2_PACKAGE_CRYPTSETUP=y
BR2_PACKAGE_UTIL_LINUX=y
BR2_PACKAGE_UTIL_LINUX_LIBFDISK=y
BR2_PACKAGE_AUDIT=y

# ---- Core utilities -------------------------------------------------------
BR2_PACKAGE_BASH=y
BR2_PACKAGE_COREUTILS=y
BR2_PACKAGE_PROCPS_NG=y
BR2_PACKAGE_FINDUTILS=y
BR2_PACKAGE_GREP=y
BR2_PACKAGE_SED=y
BR2_PACKAGE_GAWK=y
BR2_PACKAGE_TAR=y
BR2_PACKAGE_GZIP=y
BR2_PACKAGE_LESS=y
BR2_PACKAGE_NANO=y
BR2_PACKAGE_WGET=y
BR2_PACKAGE_IPROUTE2=y
BR2_PACKAGE_IPUTILS=y
BR2_PACKAGE_NET_TOOLS=y
BR2_PACKAGE_HTOP=y
BR2_PACKAGE_LSOF=y

# ---- Fonts ----------------------------------------------------------------
BR2_PACKAGE_DEJAVU=y

# ---- electronOS custom packages ------------------------------------------
BR2_PACKAGE_ELECTRONOS_BOOT=y
BR2_PACKAGE_ELECTRONOS_LOGIN=y
BR2_PACKAGE_ELECTRONOS_SHELL=y
BR2_PACKAGE_ELECTRONOS_DESKTOP=y
```

## buildroot/external/Config.in
```kconfig
source "$BR2_EXTERNAL_ELECTRONOS_PATH/package/electronos-boot/Config.in"
source "$BR2_EXTERNAL_ELECTRONOS_PATH/package/electronos-login/Config.in"
source "$BR2_EXTERNAL_ELECTRONOS_PATH/package/electronos-shell/Config.in"
```

## buildroot/external/package/electronos-boot/Config.in
```kconfig
config BR2_PACKAGE_ELECTRONOS_BOOT
	bool "electronos-boot"
	depends on BR2_PACKAGE_PLYMOUTH
	help
	  Custom Plymouth boot theme for electronOS.
	  Displays the electronOS logo with an animated progress bar.
```

## buildroot/external/package/electronos-desktop/Config.in
```kconfig
config BR2_PACKAGE_ELECTRONOS_DESKTOP
	bool "electronos-desktop"
	select BR2_PACKAGE_ELECTRONOS_SHELL
	help
	  Graphical desktop environment for electronOS.
	  Ubuntu-style layout with Apple Liquid Glass aesthetic.
	  Includes Terminal, Settings, and Text Editor apps.
```

## buildroot/external/package/electronos-login/Config.in
```kconfig
config BR2_PACKAGE_ELECTRONOS_LOGIN
	bool "electronos-login"
	depends on BR2_PACKAGE_SDL2
	depends on BR2_PACKAGE_SDL2_IMAGE
	depends on BR2_PACKAGE_SDL2_TTF
	depends on BR2_PACKAGE_LIBPAM
	help
	  Custom graphical login manager for electronOS.
	  macOS-style login screen with PAM authentication.
```

## buildroot/external/package/electronos-shell/Config.in
```kconfig
config BR2_PACKAGE_ELECTRONOS_SHELL
	bool "electronos-shell"
	help
	  Custom command shell for electronOS.
	  Provides a user-friendly terminal interface with built-in
	  help for the 30 most common system commands.
```
